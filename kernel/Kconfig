## kernel/Kconfig
```kconfig
menu "KernelSU"

config KSU
	tristate "KernelSU function support"
	depends on EXT4_FS
	default y
	help
  Enable kernel-level root privileges on Android System.
  Requires CONFIG_EXT4_FS for `ext4_unregister_sysfs`.
  Use KSU_HOOK_CORE (syscall-table tamper and/or ARM64 branch-link)
  for the runtime hookless implementation, or KSU_MANUAL_HOOK for
  legacy kernels whose sources already contain manual KSU hooks.
  To compile as a module, choose M here: the
  module will be called kernelsu.

config KSU_DEBUG
	bool "KernelSU debug mode"
	depends on KSU
	default n
	help
	  Enable KernelSU debug mode.

config KSU_DISABLE_MANAGER
	bool "Disable KernelSU manager integration"
	depends on KSU
	default n
	help
	  Disable manager APK detection and manager-specific handling.
	  Root will be used in place of manager-only functionality.

config KSU_DISABLE_POLICY
	bool "Disable KernelSU policy profiles"
	depends on KSU
	default n
	help
	  Disable per-app root/non-root profile customization.
	  Escalation will always use the default full root profile, and
	  non-root handling will follow the global umount policy only.

# For easier extern ifdef handling
config KSU_MANUAL_HOOK
	bool "KernelSU manual hook mode."
	depends on KSU && KSU != m
	default n
	help
	  Enable manual hook support.

config KSU_HOOK_CORE
	bool "KernelSU runtime hook core (syscall-table / branch-link / LSM slot patch)"
	depends on KSU && !KSU_MANUAL_HOOK
	default y
	help
	  KernelSU's runtime interception core: syscall-table tamper
	  dispatch, ARM64 branch-link call-site patching, and the runtime
	  LSM slot patcher.  All of these patch already-existing kernel
	  binary structures; none of them require or use kprobes or
	  kretprobes.  This mode is fully independent of the kernel's
	  CONFIG_KPROBES/CONFIG_KRETPROBES settings -- enabling those for
	  unrelated purposes does not change KSU's behavior.
	  Legacy kprobe/tracepoint fallback paths (sys_enter redirect,
	  regfunc kretprobes, reboot supercall kprobe) are compiled inside
	  this block only when the kernel provides CONFIG_KPROBES/
	  CONFIG_KRETPROBES/HAVE_SYSCALL_TRACEPOINTS AND
	  KSU_TAMPER_SYSCALL_TABLE is not selected; they exist for
	  pre-hookless profile compatibility and are never active in the
	  TAMPER/BRANCH_LINK configuration.

config KSU_TAMPER_SYSCALL_TABLE
	bool "KernelSU syscall-table tamper hook"
	depends on KSU_HOOK_CORE
	depends on ARM64 || X86_64
	default y if !HAVE_SYSCALL_TRACEPOINTS
	default n
	help
	  Replace hooked syscall table entries directly instead of routing
	  them through the sys_enter tracepoint dispatcher. This mirrors the
	  downstream KernelSU syscall-table tamper mode while reusing
	  KernelSU-Next's central syscall handlers.

config KSU_HACK_ARM64_BRANCH_LINK
	bool "KernelSU ARM64 branch-link hook"
	depends on KSU_HOOK_CORE && ARM64 && KALLSYMS
	default y if ARM64
	default n
	help
	  Patch selected ARM64 syscall and VFS call sites by rewriting
	  branch-with-link instructions to KSU wrappers, so sucompat/exec
	  path handling and the hookless SUSFS/NoMount families run without
	  kprobes/kretprobes or the tracepoint dispatcher.
	  This is intended for Android ARM64 kernels with the standard syscall
	  wrapper layout and should be validated on the target device. Module
	  builds still require the hook text to land within the ARM64 BL
	  +/-128 MiB range, otherwise patching will be refused at runtime.

config KSU_BL_GENERATED
	bool "KernelSU branch-link generated manifest data object"
	depends on KSU_HACK_ARM64_BRANCH_LINK
	default n
	help
	  Compile the branch-link runtime against a generated manifest data
	  object (produced by the guarded two-stage build coordinator from
	  the exact linked kernel image) instead of the source-owned
	  bootstrap arrays.  When enabled, a missing, stale, or malformed
	  generated object FAILS CLOSED: the whole branch-link subsystem
	  stays disabled and any probe-based fallbacks remain authoritative.
	  The generated object stores symbol names and enum IDs only; the
	  runtime continues to resolve and verify every target at boot.

config KSU_HOOKLESS_SUSFS
	bool "KernelSU hookless SUSFS"
	depends on KSU && KSU != m && KSU_HOOK_CORE
	default n
	help
	  Enable the hookless SUSFS runtime hosted entirely inside
	  KernelSU-Next. This keeps SUSFS out of the main kernel tree and
	  relies on KSU-owned VFS/procfs/syscall runtime hooks instead of
	  per-version source patching.
	  MM and VFS compatibility is selected from the APIs present in the
	  source tree. Stock-style 4.19 and 5.4 ARM64 kernels are the primary
	  legacy targets; 4.9 is best-effort when all syscall
	  tracepoint, procfs, and Android vendor dependencies are present.
	  Supported on this branch:
	  - sus_path / add_sus_path
	  - sus_path_loop / add_sus_path_loop
	  - open_redirect / add_open_redirect
	  - sus_mount / hide_sus_mnts_for_non_su_procs
	  - sus_kstat / add_sus_kstat / update_sus_kstat
	  - sus_map / add_sus_map
	  - spoof_cmdline_or_bootconfig
	    (cmdline only on kernels without proc bootconfig)
	  - spoof_uname
	  - avc_log_spoofing
	  When KSU_HACK_ARM64_BRANCH_LINK is enabled on ARM64, SUSFS uses
	  direct branch-link/function-pointer hooks for kstat and mount
	  tracking instead of installing its kprobe/kretprobe runtime hooks.

config KSU_HOOKLESS_NOMOUNT
	bool "KernelSU hookless NoMount"
	depends on KSU_HOOKLESS_SUSFS
	depends on KEYS
	depends on ARM64
	depends on KALLSYMS
	default y
	help
	  Enable a KernelSU-hosted NoMount-compatible VFS redirection
	  runtime. This keeps NoMount out of fs/ and redirects pathnames at
	  the native filename constructors, while preserving the keyring
	  transport and command ABI used by the existing nm userspace
	  tool.

	  The runtime is driven through a "nomount" key type: the client
	  hands the kernel a one-shot command with add_key(2), and the
	  kernel applies it while the key type parses that payload. The
	  permission check requires CAP_SYS_ADMIN in the initial user
	  namespace, so an unprivileged app cannot install NoMount rules.

	  This implementation supports exact child injection, replacement,
	  whiteout, synthetic intermediate virtual directories, UID
	  blocking, rule listing, and clear commands. It intentionally
	  avoids fabricated inodes and superblock/VFS-operation wrappers.
	  Interception is implemented with existing compiled call-site
	  branch rewrites and existing function-pointer/ops-table patches;
	  Android ARM64 4.19 and 5.4 configurations are the supported
	  targets.

endmenu
```
